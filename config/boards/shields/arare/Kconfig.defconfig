## config/boards/shields/arare/Kconfig.defconfig
```kconfig
if SHIELD_ARARE_L || SHIELD_ARARE_R

config ZMK_KEYBOARD_NAME
    default "arare"

config ZMK_SPLIT
    default y

if SHIELD_ARARE_R

config ZMK_SPLIT_ROLE_CENTRAL
    default y

endif # SHIELD_ARARE_R

endif # SHIELD_ARARE_L || SHIELD_ARARE_R
```

## config/west.yml
```yaml
manifest:
  remotes:
    - name: zmkfirmware
      url-base: https://github.com/zmkfirmware
    - name: sayu-hub
      url-base: https://github.com/sayu-hub
    - name: caksoylar
      url-base: https://github.com/caksoylar
  projects:
    - name: zmk
      remote: zmkfirmware
      revision: v0.2.1
      import: app/west.yml
    - name: zmk-pmw3610-driver
      remote: sayu-hub
      revision: main
      path: modules/zmk-pmw3610-driver
    - name: zmk-rgbled-widget
      remote: caksoylar
      revision: 6d8e399c
      path: modules/zmk-rgbled-widget
  self:
    path: config
```
